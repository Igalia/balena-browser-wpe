## yocto/conf/layer.conf
```bitbake
BBPATH .= ":${LAYERDIR}"

BBFILES += "${LAYERDIR}/recipes-*/*/*.bb \
            ${LAYERDIR}/recipes-*/*/*.bbappend"

BBFILE_COLLECTIONS += "wpe"
BBFILE_PATTERN_wpe := "^${LAYERDIR}/"
BBFILE_PRIORITY_wpe = "99"

LAYERSERIES_COMPAT_wpe = "hardknott"
```
